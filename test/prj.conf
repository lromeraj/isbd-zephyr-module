## CMakeLists.txt
```
# SPDX-License-Identifier: Apache-2.0

cmake_minimum_required(VERSION 3.20.0)

set(BOARD frdm_k64f)

find_package(Zephyr REQUIRED HINTS $ENV{ZEPHYR_BASE})
project(isbd_test)

target_sources(app PRIVATE 
  ../src/utils.c
  ../src/zuart.c
  ../src/at.c
  ../src/at_uart.c
  ../src/isbd.c
  ./src/test_zuart.c )
```

## sample.yaml
```
tests:
  tests.zuart:
    tags: serial uart
    platform_allow: frdm_k64f native_posix
```

## prj.conf
```kconfig
CONFIG_SERIAL=y
CONFIG_UART_INTERRUPT_DRIVEN=y
CONFIG_MAIN_STACK_SIZE=8192
CONFIG_NEWLIB_LIBC=y
CONFIG_PRINTK=y
CONFIG_RING_BUFFER=y
CONFIG_ZTEST=y
CONFIG_ZTEST_NEW_API=y
CONFIG_HEAP_MEM_POOL_SIZE=2048
```

## src/test_zuart.c
```c
#include <zephyr/ztest.h>
#include <zephyr/kernel.h>

ZTEST_SUITE(framework_tests, NULL, NULL, NULL, NULL, NULL);

/**
 * @brief Test Asserts
 *
 * This test verifies various assert macros provided by ztest.
 *
 */
ZTEST(framework_tests, test_assert)
{
	zassert_true(1, "1 was false");
	zassert_false(0, "0 was true");
	zassert_is_null(NULL, "NULL was not NULL");
	zassert_not_null("foo", "\"foo\" was NULL");
	zassert_equal(1, 1, "1 was not equal to 1");
	zassert_equal_ptr(NULL, NULL, "NULL was not equal to NULL");
}
```
