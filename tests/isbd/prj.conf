## CMakeLists.txt
```
cmake_minimum_required(VERSION 3.20.0)

if(QEMU_PIPE)

  # This flags will be passed to QEMU.
  # This is used to create a virtual PTY in order to communicate
  # with the virtual device
  set(QEMU_TTY_PATH "/tmp/tests.isbd.ttyS0")
  set(TEST_SETUP_PATH "${CMAKE_CURRENT_SOURCE_DIR}/setup.sh")

  set(
    ENV{QEMU_EXTRA_FLAGS}
    "-chardev serial,id=con1,path=${QEMU_TTY_PATH} \
		-serial chardev:con1" )

  execute_process(
    COMMAND bash ${TEST_SETUP_PATH} ${QEMU_TTY_PATH}
      INPUT_FILE /dev/null
      OUTPUT_FILE /dev/null
      ERROR_FILE /dev/null )

endif()

get_filename_component(
  IRIDIUM_MODULE_PATH ${CMAKE_CURRENT_SOURCE_DIR}/../../ REALPATH )

list( APPEND ZEPHYR_EXTRA_MODULES ${IRIDIUM_MODULE_PATH} )

find_package(
  Zephyr REQUIRED HINTS $ENV{ZEPHYR_BASE})

project( isbd_test )

target_sources(
  app PRIVATE src/test_isbd.c)

target_link_libraries( app PRIVATE iridium )

# ../boards/arm/qemu_cortex_m3/qemu_cortex_m3.dts

# add_custom_command(
#     COMMAND touch ${CMAKE_CURRENT_SOURCE_DIR}/BLABLABLA
#     WORKING_DIRECTORY ${CMAKE_CURRENT_SOURCE_DIR}
#     OUTPUT  ${CMAKE_CURRENT_SOURCE_DIR}/BLABLABLA
#     COMMENT "Running CRC32 check..."
# )
# add_custom_target(
#     test_setup ALL
#     DEPENDS ${CMAKE_CURRENT_SOURCE_DIR}/BLABLABLA
# )

# add_dependencies(run test_setup)
```

## prj.conf
```kconfig
CONFIG_SERIAL=y
CONFIG_IRIDIUM=y
CONFIG_NEWLIB_LIBC=y
CONFIG_PRINTK=y
CONFIG_ZTEST=y
CONFIG_ZTEST_NEW_API=y
CONFIG_QEMU_ICOUNT=n
CONFIG_ZTEST_STACK_SIZE=4096
CONFIG_MAIN_STACK_SIZE=4096
```

## src/test_isbd.c
```c
#include <zephyr/ztest.h>
#include <zephyr/kernel.h>
#include <zephyr/device.h>
#include <zephyr/drivers/uart.h>
#include <zephyr/sys/multi_heap.h>

#include "isu.h"
#include "isu/dte.h"

#include "isbd/util.h"

#define RX_BUF_SIZE    256
#define TX_BUF_SIZE    256

#define ISBD_UART_NODE        DT_NODELABEL( uart1 )
#define ISBD_UART_DEVICE      DEVICE_DT_GET( ISBD_UART_NODE )

static uint8_t rx_buf[ RX_BUF_SIZE ];
static uint8_t tx_buf[ TX_BUF_SIZE ];

static isu_dte_config_t g_isu_dte_config = {
  .at_uart = {
    .echo = false,
    .verbose = false,
    // .zuart = ZUART_CONF_POLL( (struct device*)ISBD_UART_DEVICE ),
    .zuart = ZUART_CONF_IRQ( (struct device*)ISBD_UART_DEVICE, rx_buf, RX_BUF_SIZE, tx_buf, TX_BUF_SIZE ),
    // .zuart = ZUART_CONF_MIX_RX_IRQ_TX_POLL( (struct device*)ISBD_UART_DEVICE, rx_buf, sizeof( rx_buf ) ),
    // .zuart = ZUART_CONF_MIX_RX_POLL_TX_IRQ( (struct device*)ISBD_UART_DEVICE, tx_buf, sizeof( tx_buf ) ),
  }
};

static isu_dte_t g_isu_dte;

static void* isbd_suite_setup(void) {
  
  struct uart_config config;

  uart_config_get( ISBD_UART_DEVICE, &config );
  config.baudrate = 19200;
  uart_configure( ISBD_UART_DEVICE, &config );

  isu_dte_err_t ret;
  ret = isu_dte_setup( &g_isu_dte, &g_isu_dte_config );

  zassert_equal( ret, ISU_DTE_OK, "Setup failed" );

  return NULL;
}


ZTEST( isbd_suite, test_imei ) {

  int16_t ret;
  char imei[ 16 ];

  ret = isu_get_imei( &g_isu_dte, imei, sizeof( imei ) );
  
  zassert_equal( ret, ISU_DTE_OK, "Could not fetch IMEI" );
  zassert_equal( strlen( imei ), 15, "IMEI length mismatch" );
  
}


ZTEST( isbd_suite, test_mo_mt ) {

  /**
   * @brief Set mobile originated buffer with a
   * sample message
   */
  isu_dte_err_t ret;
  const uint8_t msg[] = { 
    0x34, 0x1E, 0x45, 0x23, 0x34, 0xBB, 0xCC, 0x54, 0x32, 0x13, 0x34, 0xA5
  };
  const uint16_t msg_len = sizeof( msg );
  const uint16_t msg_csum = isbd_util_compute_checksum( msg, msg_len );

  ret = isu_set_mo( &g_isu_dte, msg, sizeof( msg ) );
  
  zassert_equal( ret, ISU_DTE_OK, 
    "Could not set MO buffer" );

  /**
   * @brief Transfer mobile originated buffer to the
   * mobile terminated buffer
   */
  ret = isu_mo_to_mt( &g_isu_dte, NULL, 0 );
  
  // check if the MT buffer was successfully read
  zassert_equal( ret, ISU_DTE_OK, 
    "Could not transfer message from MO to MT" );

  /**
   * @brief Now we check if the mobile terminated buffer
   * contains exactly the same as the original message
  */
  uint16_t mt_csum;
  char mt_buf[ msg_len ];
  uint16_t mt_len = sizeof( mt_buf );

  ret = isu_get_mt( &g_isu_dte, mt_buf, &mt_len, &mt_csum );

  // check if MT buffer could be fetched
  zassert_equal( ret, ISU_DTE_OK, 
    "Could not fetch MT buffer" );

  zassert_equal( mt_len, msg_len, 
    "MT message length mismatch" );
  
  // check if message content is exactly the same
  for ( uint16_t i=0; i < mt_len; i++ ) {
    zassert_equal( mt_buf[ i ], msg[ i ], 
      "MT message content mismatch" );
  }

  // compute checksum
  zassert_equal( msg_csum, mt_csum, 
    "MT checksum mismatch" );

  /**
   * @brief Here we try to send an empty message
   * expecting an error result
   */
  const char empty_msg[] = {};
  ret = isu_set_mo( &g_isu_dte, empty_msg, sizeof( empty_msg ) );

  zassert_equal( ret, ISU_DTE_ERR_CMD );
  zassert_equal( isu_dte_get_err( &g_isu_dte ), 3 );

  ret = isu_clear_buffer( &g_isu_dte, ISU_CLEAR_MO_MT_BUFF );
  zassert_equal( ret, ISU_DTE_OK );

  // - 0 - SBD message successfully written to the 9602.
  // - 1 - SBD message write timeout. An insufficient number of bytes were transferred to 9602
  // during the transfer period of 60 seconds.
  // - 2 - SBD message checksum sent from DTE does not match the checksum calculated by the
  // 9602.
  // - 3 - SBD message size is not correct. The maximum mobile originated SBD message length
  // is 340 bytes. The minimum mobile originated SBD message length is 1 byte.

}

// TODO: move this to a new AT-UART test module
ZTEST( isbd_suite, test_overflow ) {

  int16_t ret;
  char imei[ 15 ];

  // this should trigger overflow error because
  // there is not enough space to write trailing \0
  ret = isu_get_imei( &g_isu_dte, imei, sizeof( imei ) );
  
  zassert_equal( ret, ISU_DTE_ERR_AT );
  zassert_equal( isu_dte_get_err( &g_isu_dte ), AT_UART_OVERFLOW, 
    "Overflow not triggered" );
  
}

ZTEST_SUITE( isbd_suite, NULL, isbd_suite_setup, NULL, NULL, NULL );
```

## src/test_zuart.c
```c
#include <zephyr/ztest.h>
#include <zephyr/kernel.h>
#include <zephyr/device.h>
#include <zephyr/drivers/uart.h>
#include <zephyr/sys/multi_heap.h>

#include "zuart.h"

#define UART_HOST_NODE DT_NODELABEL(uart1)

static const struct device *uart_slave_device = 
  DEVICE_DT_GET( UART_HOST_NODE );

struct zuart_suite_fixture {
  zuart_t zuart;
  uint8_t rx_buf[64];
  uint8_t tx_buf[64];
};

static void* zuart_suite_setup(void) {

  struct zuart_suite_fixture *fixture = 
    k_malloc( sizeof( struct zuart_suite_fixture ) );

  zassume_not_null( fixture );

  // zuart_config_t zuart_config = ZUART_CONF_POLL( uart_slave_device );
  zuart_config_t zuart_config = ZUART_CONF_IRQ( uart_slave_device, 
    fixture->rx_buf, sizeof( fixture->rx_buf ), fixture->tx_buf, sizeof( fixture->tx_buf ) );

  struct uart_config config;

  uart_config_get( uart_slave_device, &config );
  config.baudrate = 115200;
  uart_configure( uart_slave_device, &config );

  zassert_equal( zuart_setup( &fixture->zuart, &zuart_config ), ZUART_OK, "Setup error" );

  return fixture;
}

ZTEST_SUITE(zuart_suite, NULL, zuart_suite_setup, NULL, NULL, NULL);

uint32_t read_line( zuart_t *zuart ) {

  int32_t ret;
  uint8_t byte;
  uint32_t rx_size = 0;
  while ( (ret = zuart_read( zuart, &byte, 1, 0 ) ) >= 0 ) {
    rx_size += ret;
    if ( byte == '\n' ) break;
  }
  return rx_size;
}

ZTEST_F( zuart_suite, test_setup ) {
  
}

ZTEST_F( zuart_suite, test_overrun ) {

  int32_t ret; 
  uint16_t write_buf_len;

  char read_buf[ 16 ];
  char write_buf[ 16 ];

  write_buf_len = sprintf( write_buf, "ping\n" );
  
  do {
    zuart_write( &fixture->zuart, write_buf, write_buf_len, 0 );
    
    // accept any byte as response
    ret = zuart_read( &fixture->zuart, read_buf, 1, 100 );

  } while ( ret != 1 );

  write_buf_len = sprintf( write_buf, "flood %d\n", sizeof( fixture->rx_buf ) + 1 );

  zuart_write( &fixture->zuart, write_buf, write_buf_len, 1000 );

  // wait enough to receive whole flood
  k_msleep( 100 );

  // overrun should be returned
  ret = zuart_read( &fixture->zuart, read_buf, 1, 0 );

  zassert_equal( ret, ZUART_ERR_OVERRUN, "Overrun not triggered" );

  write_buf_len = sprintf( write_buf, "close\n" );

  zuart_write( &fixture->zuart, write_buf, write_buf_len, 1000 );

  // printk( "RX SIZE: %d ~ %d\n", rx_size, (rx_size * 8 * 1000)/19200 );
  // printk( "TX SIZE: %d ~ %d\n", tx_size, (tx_size * 8 * 1000)/19200 );

	// zassert_false(0, "0 was true");
	// zassert_is_null(NULL, "NULL was not NULL");
	// zassert_not_null("foo", "\"foo\" was NULL");
	// zassert_equal_ptr(NULL, NULL, "NULL was not equal to NULL");
}
```
