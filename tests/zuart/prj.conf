## CMakeLists.txt
```
# SPDX-License-Identifier: Apache-2.0
cmake_minimum_required(VERSION 3.20.0)

if(QEMU_PIPE)

  # This flags will be passed to QEMU which in this case
  # are used to create a virtual PTY in order to communicate
  # with the virtual device

  set(QEMU_TTY_PATH "/tmp/tests.zuart.ttyS0")
  set(TEST_SETUP_PATH "${CMAKE_CURRENT_SOURCE_DIR}/setup.sh")

  set(
    ENV{QEMU_EXTRA_FLAGS}
    "-chardev serial,id=con1,path=${QEMU_TTY_PATH} -serial chardev:con1" )

  execute_process( COMMAND bash ${TEST_SETUP_PATH} ${QEMU_TTY_PATH}
    INPUT_FILE /dev/null
    OUTPUT_FILE /dev/null
    ERROR_FILE /dev/null )

endif()

get_filename_component(
  IRIDIUM_MODULE_PATH ${CMAKE_CURRENT_SOURCE_DIR}/../../ REALPATH )

list( APPEND ZEPHYR_EXTRA_MODULES ${IRIDIUM_MODULE_PATH} )

find_package(Zephyr REQUIRED HINTS $ENV{ZEPHYR_BASE})
project( zuart_test )

target_sources( app PRIVATE
	src/test_zuart.c )

target_link_libraries( app PUBLIC zuart )

# ../boards/arm/qemu_cortex_m3/qemu_cortex_m3.dts
```

## prj.conf
```kconfig
CONFIG_SERIAL=y
CONFIG_Z_UART=y
CONFIG_MAIN_STACK_SIZE=4096
CONFIG_NEWLIB_LIBC=y
CONFIG_PRINTK=y
CONFIG_RING_BUFFER=y
CONFIG_ZTEST=y
CONFIG_ZTEST_NEW_API=y
CONFIG_HEAP_MEM_POOL_SIZE=2048
CONFIG_QEMU_ICOUNT=n
```

## src/test_zuart.c
```c
#include <zephyr/ztest.h>
#include <zephyr/kernel.h>
#include <zephyr/device.h>
#include <zephyr/drivers/uart.h>
#include <zephyr/sys/multi_heap.h>

#include "zuart.h"

#define ISBD_UART_NODE        DT_NODELABEL( uart1 )
#define ISBD_UART_DEVICE      DEVICE_DT_GET( ISBD_UART_NODE )

struct zuart_suite_fixture {
  zuart_t zuart;
  uint8_t rx_buf[64];
  uint8_t tx_buf[64];
};

static void* zuart_suite_setup(void) {

  struct zuart_suite_fixture *fixture = 
    k_malloc( sizeof( struct zuart_suite_fixture ) );

  zassume_not_null( fixture );

  // zuart_config_t zuart_config = ZUART_CONF_POLL( (struct device*)ISBD_UART_DEVICE );

  zuart_config_t zuart_config = ZUART_CONF_IRQ( 
    (struct device*)ISBD_UART_DEVICE, 
    fixture->rx_buf, sizeof( fixture->rx_buf ), 
    fixture->tx_buf, sizeof( fixture->tx_buf ) );

  struct uart_config config;

  uart_config_get( ISBD_UART_DEVICE, &config );
  config.baudrate = 115200;
  uart_configure( ISBD_UART_DEVICE, &config );
  
  zuart_err_t ret = zuart_setup( &fixture->zuart, &zuart_config );

  zassert_equal( ret, ZUART_OK, "Setup error" );

  return fixture;
}

ZTEST_SUITE(zuart_suite, NULL, zuart_suite_setup, NULL, NULL, NULL);


// uint32_t read_line( zuart_t *zuart ) {

//   int32_t ret;
//   uint8_t byte;
//   uint32_t rx_size = 0;

//   while ( (ret = zuart_read( zuart, &byte, 1, 0 ) ) >= 0 ) {
//     rx_size += ret;
//     if ( byte == '\n' ) break;
//   }
//   return rx_size;

// }


ZTEST_F( zuart_suite, test_overrun ) {

  int32_t ret; 
  uint16_t write_buf_len;

  char read_buf[ 16 ];
  char write_buf[ 16 ];

  write_buf_len = sprintf( write_buf, "ping\n" );
  
  do {

    zuart_write( &fixture->zuart, write_buf, write_buf_len, 0 );
    
    // accept any byte as response
    ret = zuart_read( &fixture->zuart, read_buf, 1, 1000 );

  } while ( ret != 1 );

  write_buf_len = sprintf( 
    write_buf, "flood %d\n", sizeof( fixture->rx_buf ) + 1 );

  zuart_write( &fixture->zuart, write_buf, write_buf_len, 1000 );

  // wait enough to receive whole flood
  k_msleep( 100 );

  // overrun should be returned
  ret = zuart_read( &fixture->zuart, read_buf, 1, 0 );

  zassert_equal( 
    zuart_get_err( &fixture->zuart ), ZUART_ERR_OVERRUN, 
    "Overrun not triggered" );

  write_buf_len = sprintf( write_buf, "close\n" );

  zuart_write( &fixture->zuart, write_buf, write_buf_len, 1000 );

  // printk( "RX SIZE: %d ~ %d\n", rx_size, (rx_size * 8 * 1000)/19200 );
  // printk( "TX SIZE: %d ~ %d\n", tx_size, (tx_size * 8 * 1000)/19200 );

	// zassert_false(0, "0 was true");
	// zassert_is_null(NULL, "NULL was not NULL");
	// zassert_not_null("foo", "\"foo\" was NULL");
	// zassert_equal_ptr(NULL, NULL, "NULL was not equal to NULL");
}
```
