## CMakeLists.txt
```
# SPDX-License-Identifier: Apache-2.0
cmake_minimum_required(VERSION 3.20.0)

# Get absolute (real path) to the module base folder
get_filename_component(
  IRIDIUM_MODULE_PATH ${CMAKE_CURRENT_SOURCE_DIR}/../../ REALPATH )

# Append module path to the extra modules list
list( APPEND ZEPHYR_EXTRA_MODULES ${IRIDIUM_MODULE_PATH} )

if("${DEBUG}" STREQUAL "y")
	message( INFO "Debug mode has been enabled" )
	list( APPEND OVERLAY_CONFIG "dbg.conf" )
endif()

if(DEFINED QEMU_TTY_PATH)
  set(
    ENV{QEMU_EXTRA_FLAGS}
    "-chardev serial,id=con1,path=${QEMU_TTY_PATH} -serial chardev:con1" )
endif()

# Look up Zephyr package using ZEPHYR_BASE
# environment variable as reference
find_package( Zephyr REQUIRED HINTS $ENV{ZEPHYR_BASE} )
project( isu_sbd_app )

# FILE( GLOB app_sources src/*.c )

target_sources( app PRIVATE 
  src/main.c 
  src/rgb.c )

# Link libraries to the target
target_link_libraries( app PRIVATE iridium )
```

## sample.yaml
```
sample:
  name: Usage sample of Iridium SBD application
```

## prj.conf
```kconfig
CONFIG_PRINTK=y
CONFIG_IRIDIUM=y
CONFIG_ISBD_THREAD_STACK_SIZE=4096
CONFIG_MAIN_THREAD_PRIORITY=0
CONFIG_MAIN_STACK_SIZE=8192
CONFIG_HEAP_MEM_POOL_SIZE=8192
CONFIG_NEWLIB_LIBC=y
CONFIG_QEMU_ICOUNT=n

CONFIG_LOG=y
CONFIG_LOG_PROCESS_THREAD_PRIORITY=0
CONFIG_LOG_PROCESS_THREAD_CUSTOM_PRIORITY=y

CONFIG_LOG_MAX_LEVEL=3
CONFIG_LOG_DEFAULT_LEVEL=3
CONFIG_LOG_BACKEND_SHOW_COLOR=y
CONFIG_LOG_BACKEND_FORMAT_TIMESTAMP=n


# Led
CONFIG_LED_STRIP=y
CONFIG_WS2812_STRIP=y
CONFIG_WS2812_STRIP_SPI=y
CONFIG_SPI=y
CONFIG_LED_STRIP_LOG_LEVEL_DBG=y
#CONFIG_GPIO=y
```

## dbg.conf
```kconfig
CONFIG_SERIAL=y
CONFIG_LOG=y
CONFIG_LOG_MAX_LEVEL=4
CONFIG_LOG_DEFAULT_LEVEL=4
```

## prj-log.conf
```kconfig
CONFIG_SERIAL=y
CONFIG_LOG=y
CONFIG_LOG_MAX_LEVEL=4
CONFIG_LOG_DEFAULT_LEVEL=4
CONFIG_LOG_BACKEND_SHOW_COLOR=y
```

## src/main.c
```c
/**
 * @file main.c
 * @author Javier Romera Llave (lromerajdev@gmail.com)
 * @brief 
 * @version 0.1
 * @date 2023-04-07
 * 
 * @copyright Copyright (c) 2023
 * 
 */

// https://community.nxp.com/t5/Kinetis-Microcontrollers/My-k64F-board-just-has-a-bootloader-on-it-now-I-cant-find-a-mbed/m-p/619471

#include <string.h>
#include <stdio.h>
#include <stdbool.h>

#include <zephyr/kernel.h>
#include <zephyr/device.h>
#include <zephyr/drivers/uart.h>
#include <zephyr/drivers/gpio.h>
#include <zephyr/logging/log.h>

#include "rgb.h"
#include "shared.h"

LOG_MODULE_REGISTER( app );

// LOG_MODULE_REGISTER( isu_sbd_cmds, LOG_LEVEL_DBG );

#include "isbd.h"

#define DO_FOREVER while (1)

#define MO_MSG_RETRIES 8

#ifdef CONFIG_BOARD_FRDM_K64F

  #define LED0_NODE DT_ALIAS( led0 )
  #define LED1_NODE DT_ALIAS( led1 )
  #define LED2_NODE DT_ALIAS( led2 )

  static const struct gpio_dt_spec red_led    = GPIO_DT_SPEC_GET( LED2_NODE, gpios );
  static const struct gpio_dt_spec blue_led   = GPIO_DT_SPEC_GET( LED1_NODE, gpios );
  static const struct gpio_dt_spec green_led  = GPIO_DT_SPEC_GET( LED0_NODE, gpios );

  #define RED_LED &red_led
  #define BLUE_LED &blue_led
  #define GREEN_LED &green_led

  #define TURN_ON_LED( led ) \
    gpio_pin_configure_dt( led, GPIO_OUTPUT_ACTIVE );

  #define TURN_OFF_LED( led ) \
    gpio_pin_configure_dt( led, GPIO_OUTPUT_INACTIVE );

#else

  #define RED_LED
  #define BLUE_LED
  #define GREEN_LED

  #define TURN_ON_LED( led )
  #define TURN_OFF_LED( led )

#endif

static isu_dte_t g_isu_dte;
static struct device *uart_960x_device = UART_960X_DEVICE;

void clear_leds() {
  TURN_OFF_LED( BLUE_LED );
  TURN_OFF_LED( GREEN_LED );
  TURN_OFF_LED( RED_LED );
}

void set_warning_led() {
  clear_leds();
  TURN_ON_LED( RED_LED );
  TURN_ON_LED( GREEN_LED );
}

void set_error_led() {
  clear_leds();
  TURN_ON_LED( RED_LED );
}

void set_success_led() {
  clear_leds();
  TURN_ON_LED( GREEN_LED );
}

void set_info_led() {
  clear_leds();
  TURN_ON_LED( BLUE_LED );
}

static inline void _isbd_evt_handler( isbd_evt_t *evt );

static uint8_t rx_buf[ 512 ];
static uint8_t tx_buf[ 512 ];

int main(void) {

	if ( !device_is_ready( uart_960x_device ) ) {
		LOG_ERR( "UART device not found" );
		return 1;
  }

  struct uart_config uart_config;

	uart_config_get( uart_960x_device, &uart_config );
	uart_config.baudrate = 19200;
	uart_configure( uart_960x_device, &uart_config );

  isu_dte_config_t isu_dte_config = {
    .at_uart = {
      .echo = true,
      .verbose = true,
      // .zuart = ZUART_CONF_POLL( uart_960x_device ),
      .zuart = ZUART_CONF_IRQ( uart_960x_device, rx_buf, sizeof( rx_buf ), tx_buf, sizeof( tx_buf ) ),
      // .zuart = ZUART_CONF_MIX_RX_IRQ_TX_POLL( uart_960x_device, rx_buf, sizeof( rx_buf ) ),
      // .zuart = ZUART_CONF_MIX_RX_POLL_TX_IRQ( uart_960x_device, tx_buf, sizeof( tx_buf ) ),
    }
  };
  

  LOG_INF( "%s", "Setting up DTE ..." );

  if ( isu_dte_setup( &g_isu_dte, &isu_dte_config ) == ISU_DTE_OK ) {
    LOG_INF( "%s", "Modem OK" );
    set_info_led();
  } else {
    LOG_ERR( "%s", "Could not talk to modem, probably busy ..." );
    set_warning_led();
    return 1;
  }

  isbd_config_t isbd_config = 
    ISBD_DEFAULT_CONF( &g_isu_dte );

  isbd_config.sigq_threshold = 3;

  LOG_INF( "%s", "Setting up Iridium SBD service ..." );

  isbd_setup( &isbd_config );

  const char *msg = "UCM - MIoT";

  isbd_send_mo_msg( msg, strlen( msg ), MO_MSG_RETRIES );

  DO_FOREVER {
    isbd_evt_t isbd_evt;
    if ( isbd_wait_evt( &isbd_evt, 1000 ) ) {
      _isbd_evt_handler( &isbd_evt );
    }
  }

  return 0;
}

static void _isbd_evt_handler( isbd_evt_t *evt ) {
  
  switch ( evt->id ) {

    case ISBD_EVT_MO:
      LOG_INF( "MO message sent, sn=%u", evt->mo.sn );
      break;

    case ISBD_EVT_MT:
      LOG_INF( "MT message received, sn=%u", evt->mt.sn );
      LOG_HEXDUMP_INF( evt->mt.data, evt->mt.len, "MT Payload" );
      break;

    case ISBD_EVT_RING:
      LOG_INF( "Ring alert received" );
      isbd_request_session( true );
      break;

    case ISBD_EVT_SIGQ:
      LOG_INF( "Signal strength: %d", evt->sigq );
      break;

    case ISBD_EVT_SVCA:
      LOG_INF( "Service availability: %d", evt->svca );
      break;

    case ISBD_EVT_ERR:
      LOG_ERR( "Error (%03d) %s", evt->err, isbd_err_name( evt->err ) );
      break;

    default:
      LOG_WRN( "Unknown event (%03d)", evt->id );
      break;
  }
  
  // ! The user is obliged to call this function,
  // ! otherwise memory leaks are a possibility
  isbd_destroy_evt( evt );

}
```

## src/rgb.c
```c
#include <zephyr/logging/log.h>
LOG_MODULE_REGISTER( rgb );

#include "rgb.h"

#define STRIP_NODE		DT_ALIAS(led_strip)
#define STRIP_NUM_PIXELS	DT_PROP(DT_ALIAS(led_strip), chain_length)

#define RGB(_r, _g, _b) { .r = (_r), .g = (_g), .b = (_b) }

static const struct device *const strip = DEVICE_DT_GET(STRIP_NODE);

#define RGB_BLACK   RGB(0x00, 0x00, 0x00)
#define RGB_RED     RGB(0xff, 0x00, 0x00)
#define RGB_GREEN   RGB(0x00, 0xff, 0x00)
#define RGB_BLUE    RGB(0x00, 0x00, 0xff)
#define RGB_WHITE   RGB(0xff, 0xff, 0xff)

static const struct led_rgb colors[] = {
	RGB(0x00, 0xff, 0x00), /* green */
	RGB(0xff, 0x00, 0x00), /* red */
	RGB(0x00, 0x00, 0xff), /* blue */
};

struct led_rgb pixels[ STRIP_NUM_PIXELS ] = {};

void rgb_setup() {
  if ( device_is_ready( strip ) ) {
		LOG_INF( "Found LED strip device %s", strip->name );
	} else {
		LOG_ERR( "LED strip device %s is not ready", strip->name );
	}
}

void rgb_show() {
//   // memset(&pixels, 0x00, sizeof(pixels));
// 	// memcpy(&pixels[cursor], &colors[color], sizeof(struct led_rgb));
  size_t cursor = 0, color = 0;
	int rc;

  while (1) {

		memset(&pixels, 0x00, sizeof(pixels));
		memcpy(&pixels[cursor], &colors[color], sizeof(struct led_rgb));
    
		rc = led_strip_update_rgb(strip, pixels, STRIP_NUM_PIXELS);

		if (rc) {
			LOG_ERR("couldn't update strip: %d", rc);
		}

		cursor++;
		if (cursor >= STRIP_NUM_PIXELS) {
			cursor = 0;
			color++;
			if (color == ARRAY_SIZE(colors)) {
				color = 0;
			}
		}

		k_sleep( K_MSEC( 500 ) );
	}

}
```

## src/rgb.h
```c
#ifndef RGB_H_
  #define RGB_H_

  #include <zephyr/kernel.h>
  #include <zephyr/drivers/led_strip.h>
  #include <zephyr/device.h>
  #include <zephyr/drivers/spi.h>
  #include <zephyr/sys/util.h>

  void rgb_setup();
  void rgb_show();



#endif
```

## src/shared.h
```c
../../shared/shared.h
```
