## lib/Kconfig
```kconfig
menu "Libraries"
	rsource "iridium/Kconfig"
	rsource "zuart/Kconfig"
	rsource "stru/Kconfig"
	rsource "at_uart/Kconfig"
endmenu
```

## lib/at_uart/Kconfig
```kconfig
menu "AT-UART"
	
	config AT_UART
		bool "Build AT-UART library"
		select Z_UART
		select STR_UTILS

endmenu
```

## lib/iridium/Kconfig
```kconfig
menu "Iridium"
	
config IRIDIUM
  bool "Build Iridium library"
  select AT_UART
  select STR_UTILS

if IRIDIUM
  
  config ISBD_THREAD_STACK_SIZE
    int "Iridium SBD service thread stack size"
    default 4096
    help 
      "Configures the thread stack size for Iridium SBD service"

  config ISBD_DTE_EVT_WAIT_TIMEOUT
    int "DTE event wait timeout"
    default 1000
    help 
      Configures how many time the thread will be blocked until a event is
      received from the ISU

endif

endmenu
```

## lib/zuart/Kconfig
```kconfig
menu "Z-UART"
	
	menuconfig Z_UART
		bool "Build Z-UART library"
		select RING_BUFFER 
		select UART_INTERRUPT_DRIVEN

endmenu
```

## test/testcase.yaml
```yaml
tests:
  tests.zuart:
    tags: serial uart
    platform_allow: qemu_cortex_m3
    extra_args: QEMU_PTY=1 # https://github.com/zephyrproject-rtos/zephyr/pull/41415
    extra_configs:
      - CONFIG_QEMU_ICOUNT=n
```

## tests/isbd/testcase.yaml
```yaml
tests:
  tests.isbd:
    tags: isbd at uart
    platform_allow: qemu_cortex_m3
#    extra_args:
    extra_configs:
      - CONFIG_QEMU_ICOUNT=n
```

## tests/zuart/testcase.yaml
```yaml
tests:
  tests.zuart:
    tags: serial uart
    platform_allow: qemu_cortex_m3
    extra_args: TEST=1
    extra_configs:
      - CONFIG_QEMU_ICOUNT=n
```
