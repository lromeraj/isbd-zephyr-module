## CMakeLists.txt
```
add_subdirectory( lib ${CMAKE_CURRENT_BINARY_DIR}/iridium )
```

## sample.yaml
```
sample:
  name: Iridium SBD Library
```

## prj.conf
```kconfig
CONFIG_SERIAL=y
CONFIG_UART_INTERRUPT_DRIVEN=y
CONFIG_MAIN_STACK_SIZE=8192
CONFIG_NEWLIB_LIBC=y
CONFIG_PRINTK=y
CONFIG_RING_BUFFER=y
CONFIG_HEAP_MEM_POOL_SIZE=4096
```

## src/main.c
```c
/**
 * @file main.c
 * @author Javier Romera Llave (lromerajdev@gmail.com)
 * @brief 
 * @version 0.1
 * @date 2023-04-07
 * 
 * @copyright Copyright (c) 2023
 * 
 */
#include <zephyr/kernel.h>
#include <zephyr/device.h>
#include <zephyr/drivers/uart.h>
#include <zephyr/drivers/gpio.h>

#include <string.h>
#include <stdio.h>
#include <stdbool.h>

#include "isu.h"
#include "message.h"

#define MSG_SIZE 32

/* change this to any other UART peripheral if desired */
// #define UART_MASTER_DEVICE_NODE DT_NODELABEL(uart0)
#define UART_SLAVE_DEVICE_NODE DT_NODELABEL( uart3 )

static struct device *uart_slave_device = 
  (struct device*)DEVICE_DT_GET( UART_SLAVE_DEVICE_NODE );

/* The devicetree node identifier for the "led0" alias. */
#define LED0_NODE DT_ALIAS( led0 )
#define LED1_NODE DT_ALIAS( led1 )
#define LED2_NODE DT_ALIAS( led2 )

static const struct gpio_dt_spec red_led    = GPIO_DT_SPEC_GET( LED2_NODE, gpios );
static const struct gpio_dt_spec blue_led   = GPIO_DT_SPEC_GET( LED1_NODE, gpios );
static const struct gpio_dt_spec green_led  = GPIO_DT_SPEC_GET( LED0_NODE, gpios );

static void isbd_print_error( isu_dte_t *isbd, isu_dte_err_t err ) {

  if ( err == ISU_DTE_ERR_AT ) {
    printk( "(%03d) @ ISU_DTE_ERR_AT", isu_dte_get_err( isbd ) );
  } else if ( err == ISU_DTE_ERR_CMD ) {
    printk( "(%03d) @ ISU_DTE_ERR_CMD", isu_dte_get_err( isbd ) );
  } else {
    printk( "(\?\?\?) @ ISU_DTE_ERR_UNK" );
  }

}

#define TEST_AT_CMD(ok_block, err_block, f_name, ... ) \
do { \
  printk( "%-20s() ", #f_name ); \
  int16_t M_g_code = f_name( __VA_ARGS__ ); \
  if ( M_g_code == ISU_DTE_OK ) { \
    printk( "OK; " ); \
    ok_block \
  } else { \
    printk( "ERR: " ); isbd_print_error( M_g_code ); printk( ";" ); \
    err_block \
  } \
  printk( "\n" ); \
} while(0)

void clear_leds() {
  gpio_pin_configure_dt( &blue_led, GPIO_OUTPUT_INACTIVE );
  gpio_pin_configure_dt( &red_led, GPIO_OUTPUT_INACTIVE );
  gpio_pin_configure_dt( &green_led, GPIO_OUTPUT_INACTIVE );
}

void set_warning_led() {
  clear_leds();

  gpio_pin_configure_dt( &red_led, GPIO_OUTPUT_ACTIVE );
  gpio_pin_configure_dt( &green_led, GPIO_OUTPUT_ACTIVE );
}

void set_error_led() {
  clear_leds();
  gpio_pin_configure_dt( &red_led, GPIO_OUTPUT_ACTIVE );
}

void set_success_led() {
  clear_leds();
  gpio_pin_configure_dt( &green_led, GPIO_OUTPUT_ACTIVE );
}

void set_info_led() {
  clear_leds();
  gpio_pin_configure_dt( &blue_led, GPIO_OUTPUT_ACTIVE );
}

static uint8_t rx_buf[ 512 ];
static uint8_t tx_buf[ 512 ];

void main(void) {

  msg_setup();
  
  /*
  if ( !gpio_is_ready_dt(&led) ) {
    return;
  }
  */

  const char *msg1 = "Hi Javier!";
  const char *msg2 = "Hi Iridium!";

  msg_enqueue( msg1, strlen( msg1 ) ); 

  /*
  gpio_pin_configure_dt( &blue_led, GPIO_OUTPUT_ACTIVE );

	if (!device_is_ready(uart_slave_device)) {
		printk("UART slave device not found!");
		return;
  }

  struct uart_config uart_config;

	uart_config_get( uart_slave_device, &uart_config );
	uart_config.baudrate = 19200;
	uart_configure( uart_slave_device, &uart_config );

  struct isu_dte_config isu_dte_config = {
    .at_uart = {
      .echo = true,
      .verbose = true,
      // .zuart = ZUART_CONF_POLL( uart_slave_device ),
      .zuart = ZUART_CONF_IRQ( uart_slave_device, rx_buf, sizeof( rx_buf ), tx_buf, sizeof( tx_buf ) ),
      // .zuart = ZUART_CONF_MIX_RX_IRQ_TX_POLL( uart_slave_device, rx_buf, sizeof( rx_buf ) ),
      // .zuart = ZUART_CONF_MIX_RX_POLL_TX_IRQ( uart_slave_device, tx_buf, sizeof( tx_buf ) ),
    }
  };

  char buf[ 256 ];

  if ( isbd_setup( &isu_dte_config ) == ISU_DTE_OK ) {
    printk( "Modem OK\n" );
  } else {
    printk( "Could not talk to modem, probably busy ...\n" );
    set_warning_led();
    return;
  }

  set_info_led();

  TEST_AT_CMD({
    printk( "Revision: %s", buf );
  }, {}, isu_get_revision, buf, sizeof( buf ) );

  // enable alerts
  TEST_AT_CMD({}, {}, isu_set_mt_alert, ISBD_MT_ALERT_ENABLED );

  isu_mt_alert_t alert;
  TEST_AT_CMD({
    printk( "MT Alert: %d", alert );
  }, {}, isu_get_mt_alert, &alert );  

  TEST_AT_CMD({
    printk( "IMEI: %s", buf );
  }, {}, isbd_960x_get_imei, buf, sizeof( buf ) );  

  const char *msg = "MIoT";

  TEST_AT_CMD({}, {}, isu_set_mo, msg, strlen( msg ) );

  TEST_AT_CMD({
    printk( "%s", buf );
  }, {}, isu_mo_to_mt, buf, sizeof( buf ) );

  uint16_t csum;
  uint16_t len = sizeof( buf );
  
  TEST_AT_CMD({
    printk("msg=\"");
    for ( int i=0; i < len; i++ ) {
      printk( "%c", buf[ i ] );
    }
    printk( "\", len=%d, csum=%04X", len, csum );
  }, {}, isu_get_mt, buf, &len, &csum );

  isu_ring_sts_t ring_sts;
  TEST_AT_CMD({
    printk( "Ring status: %d", ring_sts );
  }, {}, isbd_get_ring_sts, &ring_sts );

  */

  // isu_session_ext_t session;
  // TEST_AT_CMD({ // success

    // printk( "mo_sts=%hhu, "
    //         "mo_msn=%hu, "
    //         "mt_sts=%hhu, "
    //         "mt_msn=%hu, "
    //         "mt_length=%hu, "
    //         "mt_queued=%hu",
    // session.mo_sts,
    // session.mo_msn,
    // session.mt_sts,
    // session.mt_msn,
    // session.mt_len,
    // session.mt_queued );

  //   if ( session.mo_sts < 3 ) {
  //     set_success_led();
  //   } else {
  //     set_error_led();
  //   }

  // }, { // AT command failed
  //   set_error_led();
  // }, isu_init_session, &session );

  // TEST_AT_CMD({}, {}, isu_clear_buffer, ISBD_CLEAR_MO_MT_BUFF );

  /*
  isu_evt_report_t evt_report = {
    .mode = 1,
    .service = 1,
    .signal = 1,
  };

  TEST_AT_CMD( {}, {}, isu_set_evt_report, &evt_report );
  */

  /*
  while (1) {

    // TODO: this logic should be moved to isbd module, 
    // TODO: this is only for testing purposes
    // Remember that this blocking call will be interrupted if any command
    // is externally executed
    if ( AT_UART_UNK == at_uart_pack_txt_resp( buf, sizeof( buf ), AT_1_LINE_RESP, 10000 ) ) {
      printk("RECEIVED: %s\n", buf );
    }

  }
  */

  /*
  uint8_t signal;
  TEST_AT_CMD({
    printk( "signal_quality=%d", signal );
  }, isu_get_sig_q, &signal );
  */

  // code = isbd_set_mo_bin( msg, strlen( msg ) );

  // code = isu_clear_buffer( ISBD_CLEAR_MO_BUFF );
  // printk( "isu_clear_buffer() : %d\n", code );

  /*
  uint16_t len, csum;
  isbd_get_mt_bin( __buff, &len, &csum );
  
  for ( int i=0; i < len; i++ ) {
    printk( "%c", __buff[ i ] );
  }

  printk( " @ len = %d, csum = %04X\n", len, csum );
  */
  


  // int8_t cmd_code = isu_set_mo_txt( "hoooooo" );
  // printk( "SBDWT    : %d\n", cmd_code );

  // isu_mo_to_mt( __buff );
  // printk( "MO -> MT : %s\n", __buff );

  // isu_get_mt_txt( __buff );
  // printk( "MT       : %s\n", __buff );
  
  /*
  uint16_t len, csum;
  isbd_get_mt_bin( __buff, &len, &csum );
  
  for ( int i=0; i < len; i++ ) {
    printk( "%c", __buff[ i ] );
  }
  printk( " @ len = %d, csum = %04X\n", len, csum );
  */


  /*
  isu_set_mo_txt(
    "This is an example message. It has more than 64 bytes or I think so, we should type a little bit more abcdefghijklmnopqW" );

  isu_mo_to_mt( __buff );
  printk( "MO -> MT : %s\n", __buff );

  isu_get_mt_txt( __buff );
  printk( "MT       : %s\n", __buff );
 */

  // isbd_fetch_revision( revision );
  // printk( "Revision  : %s\n", revision );

}
```

## src/at.c
```c
#include "at.h"

#define AT_STR           "at"
#define AT_CMD_Q_STR     "?"
#define AT_CMD_EQ_STR    "="

// AT command prefix
#define AT_CMD_H          AT_STR

// AT command read suffix
#define AT_CMD_READ       AT_CMD_Q_STR AT_CMD_EOL

// AT command test suffix
#define AT_CMD_TEST       AT_CMD_EQ_STR AT_CMD_Q_STR AT_CMD_EOL

// AT command end of line
#define AT_CMD_EOL        "\r"

/**
 * @brief This macro is used to safely write into
 * a predefined AT buffer. Returns the number of bytes written into the buffer.
 */
#define BUILD_AT_CMD_RET( buff, ... ) \
  uint8_t _M_written = snprintf( buff, AT_MAX_CMD_SIZE, __VA_ARGS__ ); \
  if ( _M_written < AT_MAX_CMD_SIZE ) { \
    return _M_written; \
  } else { \
    return AT_MAX_CMD_SIZE-1; \
  }

// exec
uint8_t at_cmd_e( char *at_buf, const char *cmd_name ) {
  BUILD_AT_CMD_RET( 
    at_buf, AT_CMD_H "%s" AT_CMD_EOL, cmd_name );
}

// exec with param
uint8_t at_cmd_p( char *at_buf, const char *cmd_name, uint8_t param ) {
  BUILD_AT_CMD_RET( 
    at_buf, AT_CMD_H "%s%hhu" AT_CMD_EOL, cmd_name, param );
}

// test
uint8_t at_cmd_t( char *at_buf, const char *cmd_name ) {
  BUILD_AT_CMD_RET(
    at_buf, AT_CMD_H "%s" AT_CMD_TEST, cmd_name );
}

// read
uint8_t at_cmd_r( char *at_buf, const char *cmd_name ) {
  BUILD_AT_CMD_RET( 
    at_buf, AT_CMD_H "%s" AT_CMD_READ, cmd_name );
}

// set
uint8_t at_cmd_s( char *at_buf, const char *cmd_name, const char *params ) {
  BUILD_AT_CMD_RET(
    at_buf, AT_CMD_H "%s" AT_CMD_EQ_STR "%s" AT_CMD_EOL, cmd_name, params );
}
```

## src/at.h
```c
#ifndef AT_H_
#define AT_H_

#include <stdio.h>
#include <string.h>
#include <stdint.h>

#define AT_MAX_CMD_LEN    255
#define AT_MAX_CMD_SIZE   (AT_MAX_CMD_LEN + 1)

#define AT_DEFINE_CMD_BUFF( name ) \
  char name[ AT_MAX_CMD_SIZE ];

/**
 * @brief Used to build AT exec commands. Use this when you need
 * to execute a command without any extra params or suffixes
 * 
 * @param at_buf Output buffer, should have at least 141 bytes of space. Use __AT_BUFF macro whenever possible.
 * @param cmd_name AT command name
 * @return uint8_t bytes written to the given buffer
 */
uint8_t at_cmd_e( char *at_buf, const char *cmd_name );

/**
 * @brief 
 * 
 * @param at_buf 
 * @param cmd_name 
 * @param param 
 * @return uint8_t 
 */
uint8_t at_cmd_p( char *at_buf, const char *cmd_name, uint8_t param );

/**
 * @brief Equivalent to at_cmd_p but allows to pass a string if
 * the parameter is not just an unsigned integer
 * 
 * @param at_buf 
 * @param cmd_name 
 * @param param 
 * @return uint8_t 
 */
uint8_t at_cmd_ps( char *at_buf, const char *cmd_name, const char *param );

/**
 * @brief 
 * 
 * @param at_buf 
 * @param cmd_name 
 * @return uint8_t 
 */
uint8_t at_cmd_t( char *at_buf, const char *cmd_name );

/**
 * @brief 
 * 
 * @param at_buf 
 * @param cmd_name 
 * @return uint8_t 
 */
uint8_t at_cmd_r( char *at_buf, const char *cmd_name );

/**
 * @brief 
 * 
 * @param at_buf 
 * @param cmd_name 
 * @param params 
 * @return uint8_t 
 */
uint8_t at_cmd_s( char *at_buf, const char *cmd_name, const char *params );

#endif
```

## src/at_uart.c
```c
#include <ctype.h>
#include <zephyr/kernel.h>
#include <zephyr/device.h>
#include <zephyr/drivers/uart.h>

#include "at_uart.h"
#include "utils.h"

// For reference: https://www.etsi.org/deliver/etsi_ts/127000_127099/127007/10.03.00_60/ts_127007v100300p.pdf

// Minumum buffer size required to parse 
// at least AT string codes
#define AT_MIN_BUFF_SIZE          32

// Default AT short response timeout
#define AT_SHORT_TIMEOUT          1000 // ms

// ------------- Private AT basic command methods ---------------
/**
 * @brief Enables or disables AT quiet mode. If enabled there will not be
 * AT command responses. 
 * 
 * @note In most scenarios quiet mode should be disabled for parsing AT command
 * responses. This has been implemented for internal use only.
 * 
 * @param enable Enable or disable quiet mode
 * @return int8_t 
 */
static int8_t _at_uart_set_quiet( at_uart_t *at_uart, bool enable );

/**
 * @brief Enables or disables AT command echo. If echo is enabled, 
 * commands will be echoed back to the master device.
 * 
 * @param enable Enable or disable AT command echo
 * @return int8_t 
 */
static int8_t _at_uart_enable_echo( at_uart_t *at_uart, bool enable );

/**
 * @brief Enables or disables verbose mode. When enabled the
 * AT command responses will be a word like string, otherwise
 * an ASCII unsigned integer will be received.
 * 
 * @param enable 
 * @return int8_t 
 */
static int8_t _at_uart_set_verbose( at_uart_t *at_uart, bool enable );


/**
 * @brief Echo command characters.
 * 
 * @note If enabled, this is used as an extra check to know 
 * if the device receives correctly AT commands. 
 * This is usually not necessary except in cases
 * where connection is too noisy, and despite of this the AT command will be corrupted
 * and the device will respond with an ERROR anyway, so it's recommended to disable
 * echo in order to reduce RX serial traffic.
 * 
 * @param enable 
 * @return int8_t 
 */
static int8_t _at_uart_enable_echo( at_uart_t *at_uart, bool enable );


static int8_t _at_uart_three_wire_connection( at_uart_t *at_uart, bool using );

// --------- End of private AT basic command methods ------------


at_uart_err_t at_uart_check_echo( at_uart_t *at_uart ) {

  if ( !at_uart->config.echo || at_uart->_echoed ) {
    return AT_UART_OK;
  }

  uint8_t byte;
  uint16_t byte_i = 0;

  // This flag is used to avoid rechecking echo for segmented responses
  at_uart->_echoed = true;

  at_uart_err_t at_code = AT_UART_OK;

  while( zuart_read( &at_uart->zuart, &byte, 1, AT_SHORT_TIMEOUT ) == 1 ) {
    
    if ( byte_i == 0 && byte == '\n' ) continue;

    // ! When a mismatch is detected we have to drop all remaining chars
    // ! In case of electrical noise, the trailing char may be different
    // ! and not detected, in that case a timeout error will be returned
    // ! In case of extreme electrical noise (long/unconnected wires) 
    // ! this loop could get stuck until \r char is randomly found
    // TODO: Illegal private access, create a function inside zuart module
    // TODO: to retrieve specific transmission byte

    // ! If we want to check echo like this we have an additional buffer
    // ! to store the transmitted command, otherwise we can skip the command completely
    // if ( at_uart->zuart.buf.tx[ byte_i ] != byte ) {
    //   // Echoed command do not matches previously transmitted command
    //   at_code = AT_UART_ERR;
    // }

    byte_i++;

    if ( byte == '\r' ) {
      return at_code;
    }
  }

  return AT_UART_TIMEOUT;
}

at_uart_err_t at_uart_pack_txt_resp(
  at_uart_t *at_uart, char *buf, size_t buf_len, uint8_t lines, uint16_t timeout_ms 
) {
  
  uint8_t byte;
  uint8_t line_n = 1;

  uint16_t buf_i = 0;
  uint16_t at_buf_i = 0;

  at_uart_err_t at_code;

  // this little buffer is used to parse AT status codes like ERROR, OK, READY ...
  char at_buf[ AT_MIN_BUFF_SIZE ] = "";

  while ( zuart_read( &at_uart->zuart, &byte, 1, timeout_ms ) == 1 ) {

    // printk( "LINE: %d / %d\n", line_n, lines );
    uint8_t trail_char = 0;

    if ( byte == '\r' || byte == '\n' ) {
      trail_char = byte;
      // printk( "CHAR: %d\n", byte );
    } else {
      // printk( "CHAR: %c\n", byte );
    }

    if ( at_buf_i > 0 && trail_char == at_uart->eol ) {
      
      // TODO: AT code should be checked only in the first and last line
      at_code = at_uart_get_str_code( at_uart, at_buf );

      if ( at_code != AT_UART_UNK ) {
        return at_code;
      }

      line_n++;

      if ( line_n > lines ) {
        return AT_UART_UNK;
      }

      at_buf_i = 0;
      at_buf[ 0 ] = '\0';

    }

    if ( !trail_char ) {
      
      if ( buf
        && buf_i < buf_len - 1
        && ( lines == AT_1_LINE_RESP || line_n < lines) ) {
        
        // TODO: We should append trailing chars to source buf 
        // TODO: if response string has multiple lines

        buf[ buf_i ] = byte;

        // TODO: Put this char only when buffer is terminated
        buf[ buf_i + 1 ] = '\0';
      }

      // at buff is only used for AT command responses
      if ( at_buf_i < sizeof( at_buf ) - 1 ) {
        at_buf[ at_buf_i ] = byte;
        at_buf[ at_buf_i + 1 ] = '\0';
      }

      buf_i++;
      at_buf_i++;

    }

  }

  return AT_UART_TIMEOUT;
}

at_uart_err_t at_uart_get_cmd_resp_code( 
  at_uart_t *at_uart, int8_t *cmd_code, uint16_t timeout_ms 
) {

  // ! The size of this buff needs at least the size to store
  // ! an AT command response code which usually are between 0 and 9
  char cmd_code_buf[ AT_MIN_BUFF_SIZE ] = "";

  at_uart_err_t at_code = at_uart_pack_txt_resp( 
    at_uart, cmd_code_buf, sizeof( cmd_code_buf ), AT_1_LINE_RESP, timeout_ms );
  
  // ! We should considere conflicts when verbose mode is disabled,
  // ! in which case returned AT interface codes are also numbers 
  if ( at_code == AT_UART_UNK ) {
    *cmd_code = atoi( cmd_code_buf );
    return AT_UART_OK;
  }

  return at_code;
}

int16_t at_uart_pack_resp_code(
  at_uart_t *at_uart, char *str_code, uint16_t str_code_len, uint16_t timeout_ms
) {

  at_uart_err_t at_code = at_uart_pack_txt_resp( 
    at_uart, str_code, str_code_len, AT_1_LINE_RESP, timeout_ms );
  
  uint8_t first_char = str_code[ 0 ];
  
  // ! We should considere conflicts when verbose mode is disabled,
  // ! in which case returned AT interface codes are also numbers 
  if ( at_code == AT_UART_UNK && isdigit( first_char ) ) {
    return atoi( str_code );
  }

  return at_code;
}

inline at_uart_err_t at_uart_skip_txt_resp(
  at_uart_t *at_uart, uint8_t lines, uint16_t timeout_ms 
) {
  return at_uart_pack_txt_resp( at_uart, NULL, 0, lines, timeout_ms );
}

at_uart_err_t at_uart_write_cmd( 
  at_uart_t *at_uart, char *cmd_buf, size_t cmd_len
) {

  at_uart->_echoed = false;
  
  // ! if device tries to send async data before sending a command,
  // ! we have to skip those bytes (or save for later use)
  // ! this should not be necessary if flow control is enabled
  // if ( k_msgq_num_used_get( &g_uart.queue.rx_q ) > 0 ) {
  //   at_uart_skip_txt_resp( AT_1_LINE_RESP, AT_SHORT_TIMEOUT );
  // }

  // also fully purge queue
  zuart_drain( &at_uart->zuart );

  int32_t ret = zuart_write( 
    &at_uart->zuart, cmd_buf, cmd_len, AT_SHORT_TIMEOUT );

  if ( ret == ZUART_ERR_TIMEOUT ) {
    return AT_UART_TIMEOUT;
  }

  return at_uart_check_echo( at_uart );
}

at_uart_err_t at_uart_get_str_code( at_uart_t *at_uart, const char *buf ) {

  if ( at_uart->config.verbose ) {
    // ordered by occurrence frequency
    if ( streq( buf, "OK" ) ) {
      return AT_UART_OK;
    } else if ( streq( buf, "ERROR" ) ) {
      return AT_UART_ERR;
    }
  } else {
    if ( streq( buf, "0" ) ) {
      return AT_UART_OK;
    } else if ( streq( buf, "4" ) ) {
      return AT_UART_ERR;
    }
  }

  return AT_UART_UNK;
}

at_uart_err_t at_uart_setup( 
  at_uart_t *at_uart, at_uart_config_t *at_uart_config 
) {

  // update whole configuration
  at_uart->config = *at_uart_config;

  if ( at_uart->config.verbose ) {
    at_uart->eol = '\n';
  } else {
    at_uart->eol = '\r';
  }

  // setup underlying uart
  zuart_setup( &at_uart->zuart, &at_uart_config->zuart );


  // ! Disable quiet mode in order to parse command results
  _at_uart_set_quiet( at_uart, false );


  // ! The response code of this commands
  // ! are not checked due to the possibility of 
  // ! an initial conflicting configuration
  // ! If the result code is an error does not mean
  // ! that the change has not been applied (only for this specific cases)
  // ! The last AT test command will finally check if the configuration was
  // ! correctly applied to the ISU
  _at_uart_enable_echo( at_uart, at_uart->config.echo );
  _at_uart_set_verbose( at_uart, at_uart->config.verbose );


  // ! Enable or disable flow control depending on uart configuration
  // ! this will avoid hangs during communication
  // ! Remember that the ISU transits between different states
  // ! depending under specific circumstances, but for AT commands
  // ! flow control is implicitly disabled
  at_uart_err_t at_code;
  struct uart_config config;
  uart_config_get( at_uart->zuart.dev, &config );

  if ( config.flow_ctrl == UART_CFG_FLOW_CTRL_NONE ) {
    at_code = _at_uart_three_wire_connection( at_uart, true );
  } else {
    at_code = _at_uart_three_wire_connection( at_uart, false );
  }

  return at_code; 
}

const char *at_uart_err_to_name( at_uart_err_t code ) {
  
  if ( code == AT_UART_OK ) {
    return "AT_UART_OK";
  } else if ( code == AT_UART_ERR ) {
    return "AT_UART_ERROR";
  } else if ( code == AT_UART_TIMEOUT ) {
    return "AT_UART_TIMEOUT";
  }

  return "AT_UART_UNKNOWN";
}

// ------ Non proprietary AT basic commands implementation ------
int8_t at_uart_set_flow_control( at_uart_t *at_uart, uint8_t option ) {
  SEND_AT_CMD_P_OR_RET( at_uart, "&k", option );
  return at_uart_skip_txt_resp( 
    at_uart, AT_1_LINE_RESP, AT_SHORT_TIMEOUT );
}

int8_t at_uart_set_dtr( at_uart_t *at_uart, uint8_t option ) {
  SEND_AT_CMD_P_OR_RET( at_uart, "&d", option );
  return at_uart_skip_txt_resp( 
    at_uart, AT_1_LINE_RESP, AT_SHORT_TIMEOUT );
}

int8_t at_uart_store_active_config( at_uart_t *at_uart, uint8_t profile ) {
  SEND_AT_CMD_P_OR_RET( at_uart, "&w", profile );
  return at_uart_skip_txt_resp( 
    at_uart, AT_1_LINE_RESP, AT_SHORT_TIMEOUT );
}

int8_t at_uart_set_reset_profile( at_uart_t *at_uart, uint8_t profile ) {
  SEND_AT_CMD_P_OR_RET( at_uart, "&y", profile );
  return at_uart_skip_txt_resp( 
    at_uart, AT_1_LINE_RESP, AT_SHORT_TIMEOUT );
}

int8_t at_uart_flush_to_eeprom( at_uart_t *at_uart ) {
  SEND_AT_CMD_E_OR_RET( at_uart, "*f" );
  return at_uart_skip_txt_resp( 
    at_uart, AT_1_LINE_RESP, AT_SHORT_TIMEOUT );
}
// ---- End of proprietary AT basic commands implementation -----

// ---------------- ! (Internal use only) ! --------------------

static int8_t _at_uart_set_quiet( at_uart_t *at_uart, bool enable ) {
  SEND_AT_CMD_P_OR_RET( at_uart, "q", enable );
  return at_uart_skip_txt_resp( 
    at_uart, AT_1_LINE_RESP, AT_SHORT_TIMEOUT );
}

static int8_t _at_uart_enable_echo( at_uart_t *at_uart, bool enable ) {
  at_uart->config.echo = enable;
  SEND_AT_CMD_P_OR_RET( at_uart, "e", enable );
  return at_uart_skip_txt_resp( 
    at_uart, AT_1_LINE_RESP, AT_SHORT_TIMEOUT );
}

static int8_t _at_uart_set_verbose( at_uart_t *at_uart, bool enable ) {
  at_uart->config.verbose = enable;
  SEND_AT_CMD_P_OR_RET( at_uart, "v", enable );
  return at_uart_skip_txt_resp( 
    at_uart, AT_1_LINE_RESP, AT_SHORT_TIMEOUT );
}

static int8_t _at_uart_three_wire_connection( at_uart_t *at_uart, bool using ) {
  
  at_uart_err_t at_code;
  uint8_t en_param = using ? 0 : 3;

  at_code = at_uart_set_flow_control( at_uart, en_param );

  if ( at_code == AT_UART_OK ) {
    at_code = at_uart_set_dtr( at_uart, en_param );
  }

  return at_code;
}

// -------------------------------------------------------------
```

## src/at_uart.h
```c
#ifndef AT_UART_H_

  #define AT_UART_H_

  #include <stdint.h>
  #include <stdbool.h>

  #include "at.h"
  #include "zuart.h"

  // Expected AT command response lines
  #define AT_1_LINE_RESP    1
  #define AT_2_LINE_RESP    2
  #define AT_3_LINE_RESP    3

  /**
   * @brief Used to send a command and return automatically in case
   * of failure
   * 
   * @note This macro defines a temporary buffer to store the AT
   * command string, finally result code is used in order to return
   * automatically or not
   */
  #define SEND_AT_CMD_OR_RET( at_uart, fn, ... ) \
    do { \
      AT_DEFINE_CMD_BUFF( _M_at_buff ); \
      at_uart_code_t _M_at_code = at_uart_write_cmd( \
        at_uart, _M_at_buff, at_cmd##fn ( _M_at_buff, __VA_ARGS__ ) ); \
      if ( _M_at_code != AT_UART_OK ) { return _M_at_code; } \
    } while ( 0 );

  /**
   * @brief Exec AT command, returns in case of failure
   * @param name AT command name
   */
  #define SEND_AT_CMD_E_OR_RET( at_uart, name ) \
    SEND_AT_CMD_OR_RET( at_uart, _e, name )

  /**
   * @brief Exec AT command with parameter in place, returns in case of failure
   * @param name AT command name
   * @param param Unsigned byte param, this number will be concatenated to the AT command name
   */
  #define SEND_AT_CMD_P_OR_RET( at_uart, name, param ) \
    SEND_AT_CMD_OR_RET( at_uart, _p, name, param )

  /**
   * @brief Exec AT command with a string parameter in place, returns in case of failure
   * @param name AT command name
   * @param param String param, this string will be concatenated with the AT command name
   */
  #define SEND_AT_CMD_PS_OR_RET( at_uart, name, param ) \
    SEND_AT_CMD_OR_RET( at_uart, _ps, name, param )

  /**
   * @brief Test AT command, returns in case of failure
   * @param name AT command name
   */
  #define SEND_AT_CMD_T_OR_RET( at_uart, name ) \
    SEND_AT_CMD_OR_RET( at_uart, _t, name )

  /**
   * @brief Read AT command, returns in case of failure
   * @param name AT command name
   */
  #define SEND_AT_CMD_R_OR_RET( at_uart, name ) \
    SEND_AT_CMD_OR_RET( at_uart, _r, name )

  /**
   * @brief Set AT command, returns in case of failure
   * @param name AT command name
   * @param params A string which contains command parameters
   */
  #define SEND_AT_CMD_S_OR_RET( at_uart, name, params ) \
    SEND_AT_CMD_OR_RET( at_uart, _s, name, params )
  
  typedef enum at_uart_code {
    AT_UART_TIMEOUT     = -2,
    AT_UART_RDY         = -3,
    AT_UART_ERR         = -4,
    AT_UART_UNK         = -5,
    AT_UART_OK          = 0,
  } at_uart_code_t;

  typedef struct at_uart_config {
    bool echo;
    bool verbose;
    zuart_config_t zuart;
  } at_uart_config_t;

  typedef struct at_uart {
    bool _echoed;
    unsigned char eol; // end of line char
  
    zuart_t zuart;
    at_uart_config_t config;

  } at_uart_t;

  /**
   * @brief Setup AT UART module
   * 
   * @param at_uart_config 
   * @return at_uart_code_t 
   */
  at_uart_code_t at_uart_setup( at_uart_t *at_uart, struct at_uart_config *at_uart_config );

  /**
   * @brief Tries to retrieve AT command result code from the given string
   * 
   * @param str_buf String buffer to check
   * @return at_uart_code_t 
   */
  at_uart_code_t at_uart_get_str_code( at_uart_t *at_uart, const char *str_buf );

  /**
   * @brief Writes the given AT command directly to serial port
   * 
   * @note This function should be used while sending AT commands. 
   * In order to simplify AT command build process
   * you can use macros like: SEND_AT_CMD_<TYPE>_OR_RET.
   * 
   * @param cmd AT command string buffer
   * @param cmd_len AT command string length (skipping null terminated char).
   * This is used in order to avoid recomputing string length, useful when using
   *  SEND_AT_CMD_<TYPE>_OR_RET like macros
   * 
   * @return at_uart_code_t 
   */
  at_uart_code_t at_uart_write_cmd( at_uart_t *at_uart, char *cmd, size_t cmd_len );
  
  at_uart_code_t at_uart_check_echo( at_uart_t *at_uart );

  at_uart_code_t at_uart_pack_txt_resp( 
    at_uart_t *at_uart, char *str_resp, size_t str_resp_len, uint8_t lines, uint16_t timeout_ms );
  
  at_uart_code_t at_uart_pack_txt_resp_code( 
    at_uart_t *at_uart, int8_t *cmd_code, uint16_t timeout_ms );
  
  at_uart_code_t at_uart_skip_txt_resp( 
    at_uart_t *at_uart, uint8_t lines, uint16_t timeout_ms );

  /**
   * @brief Retrieves the corresponding string from
   * the given error code
   * 
   * @param code Error code to be named
   * @return const char* A null terminated error string
   */
  const char *at_uart_err_to_name( at_uart_code_t code );

  int8_t at_uart_set_dtr( at_uart_t *at_uart, uint8_t option );
  int8_t at_uart_set_flow_control( at_uart_t *at_uart, uint8_t option );
  int8_t at_uart_store_active_config( at_uart_t *at_uart, uint8_t profile );
  int8_t at_uart_set_reset_profile( at_uart_t *at_uart, uint8_t profile );
  int8_t at_uart_flush_to_eeprom( at_uart_t *at_uart );
  
#endif
```

## src/defs.h
```c
#ifndef ISBD_DEFS_H_
  
  #define ISBD_DEFS_H_

  #define RX_MSGQ_LEN     256

  // TODO: think in reducing buffer sizes
  #define TX_BUFF_SIZE    512 
  #define RX_BUFF_SIZE    128

  typedef enum isbd_err {
    ISBD_OK        = 0,
    ISBD_ERR,
  } isbd_err_t;

#endif
```

## src/isbd.c
```c
#include <errno.h>
#include <string.h>
#include <stdio.h>
#include <zephyr/kernel.h>
#include <zephyr/device.h>
#include <zephyr/net/net_ip.h>
#include <zephyr/drivers/uart.h>

#include "isbd.h"
#include "at_uart.h"
#include "utils.h"

#define AT_READY_STR         "READY"

/**
 * @brief Short timeout for commands which usually take
 * less than 1 second, for example: AT+CGSN
 */
#define SHORT_TIMEOUT_RESPONSE      1000 // ms

/**
 * @brief Long timeout for commands which take
 * more than 1 second, for example: AT+SBDI, AT+SBDIX, AT+CSQ, ...
 */
#define LONG_TIMEOUT_RESPONSE       (60 * 1000) // ms

struct isbd {
  struct at_uart at_uart;
  struct isbd_config config;
};

static struct isbd g_isbd = {  };

static at_uart_err_t _isbd_pack_bin_resp( 
  uint8_t *msg_buf, size_t *msg_buf_len, uint16_t *csum, uint16_t timeout_ms 
);

isbd_err_t isbd_setup( struct isbd_config *isbd_config ) {

  g_isbd.config = *isbd_config;

  at_uart_err_t at_code = at_uart_setup( 
    &g_isbd.at_uart, &isbd_config->at_uart );

  return at_code == AT_UART_OK ? ISBD_OK : ISBD_ERR;
}

int8_t isbd_get_imei( char *imei_buf, size_t imei_buf_len ) {
  SEND_AT_CMD_E_OR_RET( &g_isbd.at_uart, "+cgsn" );
  return at_uart_pack_txt_resp(
    &g_isbd.at_uart, imei_buf, imei_buf_len, AT_2_LINE_RESP, SHORT_TIMEOUT_RESPONSE );
}

int8_t isbd_get_revision( char *rev_buf, size_t rev_buf_len ) {
  SEND_AT_CMD_E_OR_RET( &g_isbd.at_uart, "+cgmr" );
  return at_uart_pack_txt_resp( 
    // TODO: Measure exact lines from AT+CGMR
    &g_isbd.at_uart, rev_buf, rev_buf_len, 10, SHORT_TIMEOUT_RESPONSE );
}

int8_t isbd_get_rtc( char *rtc_buf, size_t rtc_buf_len ) {
  SEND_AT_CMD_E_OR_RET( &g_isbd.at_uart, "+cclk" );
  return at_uart_pack_txt_resp( 
    &g_isbd.at_uart, rtc_buf, rtc_buf_len, AT_2_LINE_RESP, SHORT_TIMEOUT_RESPONSE );
}

int8_t isbd_init_session( isbd_session_ext_t *session ) {

  char buf[ 64 ];
  
  at_uart_err_t at_code;
  SEND_AT_CMD_E_OR_RET( &g_isbd.at_uart, "+sbdix" );

  at_code = at_uart_pack_txt_resp(
    &g_isbd.at_uart, buf, sizeof( buf ), AT_2_LINE_RESP, LONG_TIMEOUT_RESPONSE );
  
  // TODO: implement optimized function instead of using sscanf
  sscanf( buf, "+SBDIX:%hhu,%hu,%hhu,%hu,%hu,%hhu",
    &session->mo_sts,
    &session->mo_msn,
    &session->mt_sts,
    &session->mt_msn,
    &session->mt_len,
    &session->mt_queued );

  return at_code;
}

int8_t isbd_clear_buffer( isbd_clear_buffer_t buffer ) {

  int8_t cmd_code;
  at_uart_err_t at_code;

  SEND_AT_CMD_P_OR_RET( &g_isbd.at_uart, "+sbdd", buffer );

  // retrieve command response code
  // this is not AT command interface result code
  at_code = at_uart_get_cmd_resp_code(
    &g_isbd.at_uart, &cmd_code, SHORT_TIMEOUT_RESPONSE );

  if ( at_code == AT_UART_OK ) {
    at_code = at_uart_skip_txt_resp( 
      &g_isbd.at_uart, AT_1_LINE_RESP, SHORT_TIMEOUT_RESPONSE );
  }

  if ( at_code == AT_UART_OK ) {
    return cmd_code;
  }

  return at_code;
}


int8_t isbd_set_mo_txt( const char *txt ) {

  // ! This has been fixed, no need to append any extra trailing char
  // ! The length of text message is limited to 120 characters. 
  // ! This is due to the length limit on the AT command line interface. 
  // char __txt[ AT_SBDWT_MAX_LEN + 1 ];

  // ! If verbose mode is NOT enabled the ISU (Initial Signal Unit) returns 
  // ! the response code just after mobile terminated buffer when using +SBDRT
  // ! without any split char like \r or \n.
  // ! So we have to include manually a trailing \n
  // uint16_t len = snprintf( __txt, sizeof( __txt ), "%s", txt );

  /*
  if ( len > AT_SBDWT_MAX_LEN ) {
    __txt[ AT_SBDWT_MAX_LEN - 1 ] = '\n';
  }
  */

  SEND_AT_CMD_S_OR_RET( &g_isbd.at_uart, "+sbdwt", txt );

  return at_uart_skip_txt_resp( 
    &g_isbd.at_uart, AT_2_LINE_RESP, SHORT_TIMEOUT_RESPONSE );
}

int8_t isbd_set_mo( const uint8_t *msg, size_t msg_len ) {

  // TODO: __data buffer is not mandatory and should be
  // TODO: removed in future modifications
  uint8_t tx_buf_size = msg_len + 2;
  uint8_t tx_buf[ tx_buf_size ];

  unsigned char msg_len_buf[ 8 ];
  snprintf( msg_len_buf, sizeof( msg_len_buf ), "%d", msg_len );

  SEND_AT_CMD_S_OR_RET( &g_isbd.at_uart, "+sbdwb", msg_len_buf );
  
  // After the initial AT+SBDWB command
  // the ISU should answer with a READY string
  // but if the length is not correct or some other validity check
  // fails, the resulting value will be a code corresponding to 
  // the command context and not to the AT command interface itself
  // So if the returned code from this function is not AT_UART_OK, cmd_code
  // will NOT be updated
  int16_t cmd_code;
  at_uart_err_t at_code; 
  char str_code[ 16 ];

  cmd_code = at_uart_pack_resp_code( 
    &g_isbd.at_uart, str_code, sizeof( str_code ), SHORT_TIMEOUT_RESPONSE );

  if ( cmd_code == AT_UART_UNK 
    && streq( str_code, AT_READY_STR ) ) {

    // compute message checksum
    uint32_t sum = 0;
    for ( size_t i = 0; i < msg_len; i++ ) {
      sum += tx_buf[ i ] = msg[ i ];
    }

    uint16_t *csum = (uint16_t*)&tx_buf[ msg_len ];
    *csum = htons( sum & 0xFFFF );

    // finally write binary data to the ISU
    // MSG (N bytes) + CHECKSUM (2 bytes)
    int32_t ret = zuart_write( // ! Check ret code
      &g_isbd.at_uart.zuart, tx_buf, tx_buf_size, SHORT_TIMEOUT_RESPONSE );
    
    // retrieve the command result code
    cmd_code = at_uart_pack_resp_code(
      &g_isbd.at_uart, str_code, sizeof( str_code ), SHORT_TIMEOUT_RESPONSE ); 
  }

  // always fetch last AT code ( OK / ERR )
  at_code = at_uart_skip_txt_resp(
    &g_isbd.at_uart, AT_1_LINE_RESP, SHORT_TIMEOUT_RESPONSE );

  return at_code == AT_UART_OK ? cmd_code : at_code;
}

int8_t isbd_get_mt( uint8_t *__msg, size_t *msg_len, uint16_t *csum ) {
  SEND_AT_CMD_E_OR_RET( &g_isbd.at_uart, "+sbdrb" );
  return _isbd_pack_bin_resp(
    __msg, msg_len, csum, SHORT_TIMEOUT_RESPONSE );
}

/*
int8_t isbd_set_mo_txt_l( char *__txt ) {
  
  SEND_AT_CMD_EXT( "sbdwt" );

  int8_t cmd_code;
  isbd_at_code_t at_code = 
    at_uart_pack_txt_resp_code( &cmd_code, 100 );
  
  printk("AT CODE: %d\n", at_code );

  if ( at_code == ISBD_AT_RDY ) {

    // TODO: add \r char

    uint16_t txt_len = strlen( __txt );
    _uart_write( (uint8_t*)__txt, txt_len );

    at_code = at_uart_pack_txt_resp( NULL, AT_2_LINE_RESP, 100 );
  }

  return cmd_code;
}
*/

int8_t isbd_mo_to_mt( char *__out, size_t out_len ) {
  SEND_AT_CMD_E_OR_RET( &g_isbd.at_uart, "+sbdtc" );
  return at_uart_pack_txt_resp(
    &g_isbd.at_uart, __out, out_len, AT_2_LINE_RESP, SHORT_TIMEOUT_RESPONSE );
}

int8_t isbd_get_mt_txt( char *__mt_buff, size_t mt_buff_len ) {
  
  SEND_AT_CMD_E_OR_RET( &g_isbd.at_uart, "+sbdrt" );
  
  if ( g_isbd.config.at_uart.verbose ) {  
    return at_uart_pack_txt_resp( 
      &g_isbd.at_uart,__mt_buff, mt_buff_len, AT_3_LINE_RESP, SHORT_TIMEOUT_RESPONSE );
  } else {
    
    uint16_t len;
    at_uart_skip_txt_resp( 
      &g_isbd.at_uart, AT_1_LINE_RESP, SHORT_TIMEOUT_RESPONSE );
    
    at_uart_pack_txt_resp( 
      &g_isbd.at_uart, __mt_buff, mt_buff_len, AT_1_LINE_RESP, SHORT_TIMEOUT_RESPONSE );
    
    len = strlen( __mt_buff ) - 1;
    
    __mt_buff[ len ] = 0;
    int8_t code = atoi( &__mt_buff[ len ] ); 
    
    return code;
  }

}

at_uart_err_t _isbd_pack_bin_resp(
  // TODO: timeout could be implicitly specified
  uint8_t *msg_buf, size_t *msg_buf_len, uint16_t *csum, uint16_t timeout_ms
) {

  // TODO: this should be at_uart_get_n_bytes ...
  zuart_read( 
    &g_isbd.at_uart.zuart, (uint8_t*)msg_buf_len, 2, timeout_ms ); // message length
  
  *msg_buf_len = ntohs( *msg_buf_len );

  zuart_read( 
    &g_isbd.at_uart.zuart, msg_buf, *msg_buf_len, timeout_ms );

  zuart_read( 
    &g_isbd.at_uart.zuart, (uint8_t*)csum, 2, timeout_ms );
  
  *csum = ntohs( *csum );

  return at_uart_skip_txt_resp( 
    &g_isbd.at_uart, AT_1_LINE_RESP, timeout_ms );
}

int8_t isbd_get_sig_q( uint8_t *signal_q ) {

  char buf[ 16 ];
  SEND_AT_CMD_E_OR_RET( &g_isbd.at_uart, "+csq" );
  
  at_uart_err_t at_code = at_uart_pack_txt_resp(
    &g_isbd.at_uart, buf, sizeof( buf ), AT_2_LINE_RESP, LONG_TIMEOUT_RESPONSE );

  if ( at_code == AT_UART_OK ) {
    sscanf( buf, "+CSQ:%hhd", signal_q ); 
  }

  return at_code;
}

int8_t isbd_set_evt_report( isbd_evt_report_t *evt_report ) {

  char buf[16];

  snprintf( buf, sizeof( buf ), "%hhd,%hhd,%hhd", 
    evt_report->mode, evt_report->signal, evt_report->service );

  SEND_AT_CMD_S_OR_RET( &g_isbd.at_uart, "+cier", buf );

  // ! This command has a peculiarity,
  // ! after the command is successfully executed, it returns an OK response,
  // ! but just after that it transmits the first indicator event
  // ! so we skip those lines
  at_uart_err_t at_code = at_uart_skip_txt_resp( 
    &g_isbd.at_uart, AT_1_LINE_RESP, SHORT_TIMEOUT_RESPONSE );  

  uint8_t lines_to_skip = 
    evt_report->mode * ( evt_report->service + evt_report->signal );

  // TODO: we could return the resulting values instead of ignoring them ...
  if ( lines_to_skip > 0 ) {
    at_uart_skip_txt_resp( 
      &g_isbd.at_uart, lines_to_skip, SHORT_TIMEOUT_RESPONSE );
  }

  return at_code;
}
```

## src/isbd.h
```c
#ifndef ISBD_H_
  #define ISBD_H_

  #include <stdint.h>

  #include "at_uart.h"

  typedef enum isbd_err {
    ISBD_OK        = 0,
    ISBD_ERR,
  } isbd_err_t;

  typedef enum isbd_clear_buffer {
    ISBD_CLEAR_MO_BUFF      = 0,
    ISBD_CLEAR_MT_BUFF      = 1,
    ISBD_CLEAR_MO_MT_BUFF   = 2,
  } isbd_clear_buffer_t;

  struct isbd_config {
    struct at_uart_config at_uart;
  };

  typedef struct isbd_session_ext {
    uint8_t mo_sts, mt_sts;
    uint16_t mo_msn, mt_msn;
    uint16_t mt_len;
    uint8_t mt_queued;
  } isbd_session_ext_t;


  typedef struct evt_report {
    uint8_t mode;
    uint8_t signal;
    uint8_t service;
  } evt_report_t;

  isbd_err_t isbd_setup( struct isbd_config *config );

  /**
   * @brief Query the device for Iridium system time if available
   * 
   * @param __rtc 
   * @return int8_t 
   */
  int8_t isbd_get_rtc( char *__rtc , size_t rtc_len );

  /**
   * @brief Query the device IMEI
   * 
   * @param __imei Resulting IMEI memory buffer
   * @return int8_t
   */          
  int8_t isbd_get_imei( char *__imei, size_t imei_len );

  /**
   * @brief Query the device revision
   * 
   * @param __revision 
   * @return int8_t 
   */
  int8_t isbd_get_revision( char *__rev, size_t rev_len );

  /**
   * @brief Transfer a SBD text message from the DTE 
   * to the single mobile originated buffer.
   * 
   * @param txt SBD message with a maximum length of 120 bytes (excluding null char)
   * @return isbd_at_code_t 
   */
  int8_t isbd_set_mo_txt( const char *txt );

  /**
   * @brief Transfer a longer SBD text message from the DTE 
   * to the single mobile originated buffer.
   * 
   * @param txt SBD message with a maximum length of 340 bytes (excluding null char)
   * @return isbd_at_code_t 
   */
  // int8_t isbd_set_mo_txt_l( char *txt );

  /**
   * @brief Transfer the contents of the mobile originated buffer 
   * to the mobile terminated buffer.
   * 
   * @param __out ISU string response. Use NULL to ignore the string response
   * @return int8_t 
   */
  int8_t isbd_mo_to_mt( char *__out, size_t out_len );

  /**
   * @brief 
   * 
   * @param __msg 
   * @param msg_len 
   * @return int8_t 
   */
  int8_t isbd_get_mt( uint8_t *__msg, size_t *msg_len, uint16_t *csum );

  /**
   * @brief 
   * 
   * @param __msg 
   * @param msg_len 
   * @return int8_t 
   */
  int8_t isbd_set_mo( const uint8_t *__msg, size_t msg_len );

  /**
   * @brief This command is used to transfer a text SBD message 
   * from the single mobile terminated buffer to the DTE
   * 
   * @note The intent of this function is to provide 
   * a human friendly interface to SBD for demonstrations and application development. 
   * It is expected that most usage of SBD will be with binary messages.
   *  
   * @param __mt_buff 
   * @return int8_t 
   */
  int8_t isbd_get_mt_txt( char *__mt_buff, size_t mt_buff_len );

  /**
   * @brief 
   * 
   * @param session 
   * @return int8_t 
   */
  int8_t isbd_init_session( isbd_session_ext_t *session );

  /**
   * @brief 
   * 
   * @param session 
   * @return int8_t 
   */
  int8_t isbd_clear_buffer( isbd_clear_buffer_t buffer );

  /**
   * @brief Execution command returns the received signal strength indication <rssi> from the 9602. Response is in
the form:
   * 
   * @param signal 
   * @return int8_t 
   */
  int8_t isbd_get_sig_q( uint8_t *signal );

  int8_t isbd_set_evt_report( evt_report_t *evt_report );

#endif
```

## src/message.c
```c
#include <stdbool.h>
#include <zephyr/kernel.h>
#include <zephyr/device.h>
#include <zephyr/drivers/uart.h>

#include "isu.h"
#include "isu/evt.h"

#include "message.h"

#define QUEUE_MAX_LEN       10

#define THREAD_PRIORITY     0
#define THREAD_STACK_SIZE   4096

/* change this to any other UART peripheral if desired */
// #define UART_MASTER_DEVICE_NODE DT_NODELABEL(uart0)
#define UART_SLAVE_DEVICE_NODE DT_NODELABEL( uart3 )

static struct device *uart_slave_device = 
  (struct device*)DEVICE_DT_GET( UART_SLAVE_DEVICE_NODE );

static struct k_thread g_thread_data;
K_THREAD_STACK_DEFINE( g_thread_stack_area, THREAD_STACK_SIZE);

extern void _entry_point( void *, void *, void * );

struct msgq_item {
  uint8_t *msg;
  uint16_t msg_len;
};

static struct k_msgq g_msgq;

static char g_msgq_buf[ QUEUE_MAX_LEN * sizeof(struct msgq_item) ];

static uint8_t rx_buf[ 512 ];
static uint8_t tx_buf[ 512 ];

static isu_dte_t g_isbd;

void msg_destroy( struct msgq_item *msgq_item );
void msg_requeue( struct msgq_item *msgq_item );

bool _send( const uint8_t *msg, uint16_t msg_len ) {

  printk( "Sending message #%hu ...\n", msg_len ); 
  
  isu_dte_err_t ret;
  ret = isu_set_mo( &g_isbd, msg, msg_len );

  if ( ret == ISU_DTE_OK ) {

    isu_session_ext_t session;
    ret = isu_init_session( &g_isbd, &session, false );

    if ( ret == ISU_DTE_OK && session.mo_sts < 3 ) {
      return true;
    }

  }
  
  return false;

}

void _entry_point( void *v1, void *v2, void *v3 ) {

  struct uart_config uart_config;

	uart_config_get( uart_slave_device, &uart_config );
	uart_config.baudrate = 19200;
	uart_configure( uart_slave_device, &uart_config );

  struct isu_dte_config isu_dte_config = {
    .at_uart = {
      .echo = true,
      .verbose = true,
      // .zuart = ZUART_CONF_POLL( uart_slave_device ),
      .zuart = ZUART_CONF_IRQ( uart_slave_device, rx_buf, sizeof( rx_buf ), tx_buf, sizeof( tx_buf ) ),
      // .zuart = ZUART_CONF_MIX_RX_IRQ_TX_POLL( uart_slave_device, rx_buf, sizeof( rx_buf ) ),
      // .zuart = ZUART_CONF_MIX_RX_POLL_TX_IRQ( uart_slave_device, tx_buf, sizeof( tx_buf ) ),
    }
  };

  if ( isu_dte_setup( &g_isbd, &isu_dte_config ) == ISU_DTE_OK ) {
    printk( "Modem OK\n" );
  } else {
    printk( "Could not talk to modem, probably busy ...\n" );
    return;
  }

  isu_evt_report_t evt_report = {
    .mode = 1,
    .service = 1,
    .signal = 1,
  };

  isu_set_evt_report( &g_isbd, &evt_report );

  while ( 1 ) {

    struct msgq_item msgq_item;

    if ( k_msgq_get( &g_msgq, &msgq_item, K_NO_WAIT ) == 0 ) {
      if ( _send( msgq_item.msg, msgq_item.msg_len ) ) {
        printk( "Message sent\n" );
        msg_destroy( &msgq_item );
      } else {
        printk( "Message not sent\n" );
        msg_requeue( &msgq_item );
      }
    }

    isbd_evt_t evt;

    // printk( "Waiting for event ...\n" );
    if ( isu_evt_wait( &g_isbd, &evt, 1000 ) == ISU_DTE_OK ) {
      printk( "Event (%03d) captured\n", evt.name );
    }

  }

}

void msg_destroy( struct msgq_item *msgq_item ) {
  free( msgq_item->msg );
  msgq_item->msg = NULL;
  msgq_item->msg_len = 0;
}

void msg_requeue( struct msgq_item *msgq_item ) {
  if ( k_msgq_put( &g_msgq, msgq_item, K_NO_WAIT ) == 0 ) {
    printk( "Message #%hu was re-enqueued\n", 
      msgq_item->msg_len );
  }
}

/**
 * @brief Enqueues a message to be sent.
 * 
 * @param msg Message buffer
 * @param msg_len Message buffer length
 */
void msg_enqueue( const uint8_t *msg, uint16_t msg_len ) {

  struct msgq_item msgq_item;
  
  msgq_item.msg_len = msg_len;
  msgq_item.msg = (uint8_t*)k_malloc( sizeof(uint8_t) * msg_len );

  memcpy( msgq_item.msg, msg, msg_len );

  if ( k_msgq_put( &g_msgq, &msgq_item, K_NO_WAIT ) == 0 ) {
    printk( "Message #%hu was enqueued\n", msg_len );
  }

}

void msg_setup() {

  k_msgq_init( &g_msgq, g_msgq_buf, sizeof(struct msgq_item), QUEUE_MAX_LEN );

  k_tid_t my_tid = k_thread_create( 
    &g_thread_data, g_thread_stack_area,
    K_THREAD_STACK_SIZEOF( g_thread_stack_area ),
    _entry_point,
    NULL, NULL, NULL,
    THREAD_PRIORITY, 0, K_NO_WAIT );

}
```

## src/message.h
```c
#ifndef MESSAGE_H_
  #define MESSAGE_H_
  
  void msg_setup();
  void msg_enqueue( const uint8_t *msg, uint16_t msg_len );

#endif
```

## src/uart.h
```c
#ifndef AT_UART_H_

  #define AT_UART_H_

  #include <stdint.h>
  #include <stdbool.h>

  #include "at.h"

  // Expected AT command response lines
  #define AT_1_LINE_RESP    1
  #define AT_2_LINE_RESP    2
  #define AT_3_LINE_RESP    3

  /**
   * @brief Used to send a command and return automatically in case
   * of failure
   * 
   * @note This macro defines a temporary buffer to store the AT
   * command string, finally result code is used in order to return
   * automatically or not
   */
  #define SEND_AT_CMD_OR_RET( fn, ... ) \
    do { \
      AT_DEFINE_CMD_BUFF( _M_at_buff ); \
      at_uart_code_t _M_at_code = at_uart_write_cmd( \
        _M_at_buff, at_cmd##fn ( _M_at_buff, __VA_ARGS__ ) ); \
      if ( _M_at_code != AT_UART_OK ) { return _M_at_code; } \
    } while ( 0 );

  /**
   * @brief Exec AT command, returns in case of failure
   * @param name AT command name
   */
  #define SEND_AT_CMD_E_OR_RET( name ) \
    SEND_AT_CMD_OR_RET( _e, name )

  /**
   * @brief Exec AT command with parameter in place, returns in case of failure
   * @param name AT command name
   * @param param Unsigned byte param, this number will be concatenated to the AT command name
   */
  #define SEND_AT_CMD_P_OR_RET( name, param ) \
    SEND_AT_CMD_OR_RET( _p, name, param )

  /**
   * @brief Test AT command, returns in case of failure
   * @param name AT command name
   */
  #define SEND_AT_CMD_T_OR_RET( name ) \
    SEND_AT_CMD_OR_RET( _t, name )

  /**
   * @brief Read AT command, returns in case of failure
   * @param name AT command name
   */
  #define SEND_AT_CMD_R_OR_RET( name ) \
    SEND_AT_CMD_OR_RET( _r, name )

  /**
   * @brief Set AT command, returns in case of failure
   * @param name AT command name
   * @param params A string which contains command parameters
   */
  #define SEND_AT_CMD_S_OR_RET( name, params ) \
    SEND_AT_CMD_OR_RET( _s, name, params )

  
  typedef enum at_uart_code {
    AT_UART_TIMEOUT     = -2,
    AT_UART_RDY         = -3,
    AT_UART_ERR         = -4,
    AT_UART_UNK         = -5,
    AT_UART_OK          = 0,
  } at_uart_code_t;

  struct at_uart_config {
    bool echo;
    bool verbose;
    struct device *dev;
  };


  /**
   * @brief Setup AT UART module
   * 
   * @param at_uart_config 
   * @return at_uart_code_t 
   */
  at_uart_code_t at_uart_setup( struct at_uart_config *at_uart_config );

  /**
   * @brief Tries to retrieve AT command result code from the given string
   * 
   * @param str_buf String buffer to check
   * @return at_uart_code_t 
   */
  at_uart_code_t at_uart_get_str_code( const char *str_buf );

  /**
   * @brief Writes the given AT command directly to serial port
   * 
   * @note This function should be used while sending AT commands. 
   * In order to simplify AT command build process
   * you can use macros like: SEND_AT_CMD_<TYPE>_OR_RET.
   * 
   * @param cmd AT command string buffer
   * @param cmd_len AT command string length (skipping null terminated char).
   * This is used in order to avoid recomputing string length, useful when using
   *  SEND_AT_CMD_<TYPE>_OR_RET like macros
   * 
   * @return at_uart_code_t 
   */
  at_uart_code_t at_uart_write_cmd( char *cmd, size_t cmd_len );
  
  /**
   * @brief Writes the given buffer directly to serial port
   * 
   * @param buf Buffer to be written
   * @param buf_len Buffer length
   * @return uint16_t 
   */
  uint16_t at_uart_write( uint8_t *buf, size_t buf_len );
  uint16_t at_uart_get_n_bytes( uint8_t *bytes, uint16_t n_bytes, uint16_t timeout_ms );
  
  at_uart_code_t at_uart_check_echo();
  at_uart_code_t at_uart_pack_txt_resp( char *str_resp, size_t str_resp_len, uint8_t lines, uint16_t timeout_ms );
  at_uart_code_t at_uart_pack_txt_resp_code( int8_t *cmd_code, uint16_t timeout_ms );
  at_uart_code_t at_uart_skip_txt_resp( uint8_t lines, uint16_t timeout_ms );

  /**
   * @brief Retrieves the corresponding string from
   * the given error code
   * 
   * @param code Error code to be named
   * @return const char* A null terminated error string
   */
  const char *at_uart_err_to_name( at_uart_code_t code );

  int8_t at_uart_set_dtr( uint8_t option );
  int8_t at_uart_set_flow_control( uint8_t option );
  int8_t at_uart_store_active_config( uint8_t profile );
  int8_t at_uart_set_reset_profile( uint8_t profile );
  int8_t at_uart_flush_to_eeprom();
  
#endif
```

## src/utils.h
```c
#ifndef UTILS_H_

  #define UTILS_H_
    #include <stdbool.h>

  bool streq( const char *__src, const char *__ref );

#endif
```
